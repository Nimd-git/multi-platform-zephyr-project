/*
 * Copyright (c) 2026
 *
 * SPDX-License-Identifier: Apache-2.0
 *
 * Stacked flash 配置（WQK = QFN 5x5 1MB stacked flash）。
 */

#if defined(FLASH_SIZE) && !FLASH_SIZE && !defined(ATM_ALLOW_FLASH_DISABLE)
#error "FLASH should not be disabled for stacked flash devices. Set ATM_ALLOW_FLASH_DISABLE to allow disablement."
#endif

#if FLASH_SIZE
#if defined(STACKED_FLASH_WQK)
&flash_controller {
	clk-pin = <35>;
	csn-pin = <31>;
	d0-pin = <34>;
	d1-pin = <32>;
	d2-pin = <33>;
	d3-pin = <36>;
};
#else
#error "Unknown stacked part variant"
#endif
#endif
