## platform/boards/atmosic/atm3405_custom/Kconfig.atm3405_custom
```kconfig
# SPDX-License-Identifier: Apache-2.0
#
# ATM3405 定制板 Kconfig。

config BOARD_ATM3405_CUSTOM
	select SOC_ATM34XX_5
```

## platform/boards/atmosic/atm3405_custom/Kconfig.defconfig
```kconfig
# SPDX-License-Identifier: Apache-2.0
#
# ATM3405 定制板 Kconfig.defconfig
# 从 openair boards/atmosic/atm34evk/Kconfig.defconfig 精简而来，
# 保留 no-TZ 用户应用模式所需的最小配置集。

if SOC_ATM34XX_5

config CORTEX_M_SYSTICK
	bool
	default y

config RUNTIME_NMI
	bool
	default y

config USE_DT_CODE_PARTITION
	bool
	default y

config ARM_MPU
	bool
	default y

config HW_STACK_PROTECTION
	bool
	default y

config ARM_TRUSTZONE_M
	bool
	default y

config ARM_SECURE_BUSFAULT_HARDFAULT_NMI
	default y if TRUSTED_EXECUTION_SECURE

config TRUSTED_EXECUTION_SECURE
	bool
	default y
	depends on !$(dt_nodelabel_bool_prop,sec_tz,ns_app)

config TRUSTED_EXECUTION_NONSECURE
	bool
	default y
	depends on $(dt_nodelabel_bool_prop,sec_tz,ns_app)

config SERIAL
	bool
	default y

config CONSOLE
	bool
	default y

config UART_CONSOLE
	bool
	default y

config GPIO
	bool
	default y

config BUILD_OUTPUT_HEX
	default y

# 暂时关闭 PM：openair power.c 调用 sys_clock_correct(),
# 该函数在 Zephyr v4.4 不存在，需要后续移植 PM 子系统时解决。
config PM
	default n

if PM

config IDLE_STACK_SIZE
	int
	default 1024

endif # PM

config ATM_NO_SPE
	bool
	help
	  Application will operate a single secure image without the SPE.

config ATM_NO_TZ
	bool
	default y
	select ATM_NO_SPE
	depends on !DT_HAS_ATMOSIC_SEC_TZ_ENABLED
	depends on !MCUBOOT
	depends on !TRUSTED_EXECUTION_NONSECURE
	help
	  No TrustZone: single application as a secure image without SPE.

if SERIAL

config UART_INTERRUPT_DRIVEN
	default y

endif # SERIAL

config HEAP_MEM_POOL_ADD_SIZE_BOARD
	int
	default 512

endif # SOC_ATM34XX_5
```

## platform/boards/atmosic/atm3405_custom/atm3405_custom_defconfig
```kconfig
# SPDX-License-Identifier: Apache-2.0
#
# ATM3405 定制板默认配置。

# 电源管理（暂时关闭：sys_clock_correct 在 v4.4 不存在）
# CONFIG_PM=y
```

## platform/boards/atmosic/atm3405_custom/board.yml
```yaml
# SPDX-License-Identifier: Apache-2.0
#
# ATM3405 定制板（ATMEVK-3405-WQK-5，QFN 5x5，Cortex-M33F）。
# 发现机制：platform/zephyr/module.yml 中 build.settings.board_root = "."
# SoC 定义由 openair 模块的 soc_root 提供。

board:
  name: atm3405_custom
  full_name: ATM3405 Custom Board
  vendor: atmosic
  socs:
    - name: ATM34xx-5
```

## platform/boards/st/stm32f407ve_custom/Kconfig.stm32f407ve_custom
```kconfig
# SPDX-License-Identifier: Apache-2.0

config BOARD_STM32F407VE_CUSTOM
	select SOC_STM32F407XE
```

## platform/boards/st/stm32f407ve_custom/board.yml
```yaml
# SPDX-License-Identifier: Apache-2.0
#
# STM32F407VET6 定制板（LQFP100，512KB Flash，192KB RAM）。
# 发现机制：platform/zephyr/module.yml 中 build.settings.board_root = "."

board:
  name: stm32f407ve_custom
  full_name: STM32F407VET6 Custom Board
  vendor: st
  socs:
    - name: stm32f407xx
```

## platform/boards/st/stm32u5g9b_custom/Kconfig.stm32u5g9b_custom
```kconfig
# SPDX-License-Identifier: Apache-2.0

config BOARD_STM32U5G9B_CUSTOM
	select SOC_STM32U5G9XX
```

## platform/compat/Kconfig.compat
```kconfig
# SPDX-License-Identifier: Apache-2.0
#
# 架构图左侧“版本兼容与适配”纵柱：
#   - API 兼容层（版本宏隔离/废弃接口兼容）：见 include/platform/plat_version.h
#   - Kconfig 兼容（配置项映射/旧选项迁移）：本文件
#   - DT 兼容层（设备树绑定兼容/属性名映射）：dts/bindings 中的绑定描述
#   - HAL 适配层（多版本 HAL 共存/厂商驱动适配）：hal/Kconfig
#
# 旧选项迁移标准写法：保留旧符号为隐藏 bool，default y，并 select 新符号。
# 用户旧工程的 prj.conf 无需改动即可获得新行为；迁移期过后删除旧符号。
#
# 示例（当前树中暂无历史包袱，保留模板供后续使用）:
#
# config OLD_GPIO_POLL_API
# 	bool
# 	default y
# 	select GPIO
# 	select PLAT_GPIO_POLL_COMPAT
#
# config PLAT_GPIO_POLL_COMPAT
# 	bool "Provide legacy polling GPIO API"
# 	help
# 	  旧版本平台使用的轮询式 GPIO 接口，建议新代码直接使用 plat_gpio.h。

config PLAT_ENABLE_DEPRECATED_API
	bool "Keep deprecated platform API compatibility shims"
	default y
	depends on PLATFORM_SERVICES
	help
	  在 plat_version.h 中保留 PLAT_DEPRECATED_SINCE() 标记的旧 API 内联
	  封装。产品固件稳定后可关闭此项以回收代码体积。
```

## platform/drivers/Kconfig
```kconfig
# SPDX-License-Identifier: Apache-2.0
#
# 硬件抽象层：驱动 API 标准化（GPIO/UART/SPI/I2C）+ 自研驱动骨架

menu "Platform drivers"

config PLAT_GPIO
	bool "GPIO unified abstraction (output/input/interrupt/LED)"
	default y
	depends on GPIO
	help
	  GPIO 平台统一封装，提供输出/输入/中断/LED 标准操作接口。

config PLAT_UART
	bool "UART unified abstraction (poll/interrupt/RS485-ready)"
	default y
	depends on SERIAL
	help
	  UART 平台统一封装，提供轮询收发、中断接收、RS485 方向控制预留。

config PLAT_SPI
	bool "SPI unified abstraction (master transceive/CS control)"
	default y
	depends on SPI
	help
	  SPI 平台统一封装，提供标准全双工传输、CS 控制、寄存器读写。

config PLAT_I2C
	bool "I2C unified abstraction (master read/write/scan)"
	default y
	depends on I2C
	help
	  I2C 平台统一封装，提供标准读写、寄存器访问、总线扫描。

rsource "skeleton/Kconfig"

endmenu
```

## platform/drivers/skeleton/Kconfig
```kconfig
# SPDX-License-Identifier: Apache-2.0
#
# 自研驱动骨架：plat,platform-monitor
# 演示“统一设备模型”的标准写法：设备树 compatible 实例化 + DEVICE_DT_INST_DEFINE
# + POST_KERNEL 初始化级别 + 自定义驱动 API。QEMU 双架构均在 overlay 中
# 实例化了一个该设备，无需真实硬件即可跑通驱动加载流程。

config PLAT_MONITOR
	bool "Platform monitor skeleton driver"
	default y
	depends on DT_HAS_PLAT_PLATFORM_MONITOR_ENABLED
	help
	  使能后，驱动按设备树中 compatible = "plat,platform-monitor" 的节点
	  自动实例化，可通过 shell 命令 "platform ping" 调用其 API。
```

## platform/dts/bindings/plat,platform-monitor.yaml
```yaml
# SPDX-License-Identifier: Apache-2.0
#
# 自研骨架驱动 plat,platform-monitor 的设备树绑定。
# QEMU 双架构在 app/boards/*.overlay 中各实例化一个该节点。

description: Platform skeleton monitor device

compatible: "plat,platform-monitor"

include: base.yaml

properties:
  report-interval-ms:
    type: int
    default: 1000
    description: 周期上报间隔（毫秒），骨架驱动仅记录该参数。
```

## platform/middleware/Kconfig
```kconfig
# SPDX-License-Identifier: Apache-2.0
#
# 架构图“应用开发层”的中间件：通信（Modbus）/ 数据（JSON/CBOR）/
# UWB（SR040）/ 存储（settings KV）。图形（LVGL）暂不集成，保留占位。

menu "Platform middleware"

rsource "communication/Kconfig"
rsource "data/Kconfig"
rsource "uwb/Kconfig"
rsource "storage/Kconfig"

config PLAT_MW_GUI
	bool "GUI middleware skeleton (LVGL/display/touch)"
	default n
	depends on PLATFORM_SERVICES
	help
	  规划：LVGL 图形库集成、显示驱动与触摸输入、图形加速适配。
	  当前阶段暂不集成（用户决定以 UWB SR040 替代）。

endmenu
```

## platform/middleware/communication/Kconfig
```kconfig
# SPDX-License-Identifier: Apache-2.0
#
# 通信中间件：Modbus RTU 主站（client）

config PLAT_MW_COMMUNICATION
	bool "Communication middleware (Modbus RTU client)"
	default n
	depends on PLATFORM_SERVICES
	select MODBUS
	select MODBUS_CLIENT
	select MODBUS_SERIAL
	help
	  启用 Modbus RTU 主站封装（plat_modbus）。
	  需要在板级 overlay 中为某个 UART 增加形如：
	    modbus0 { compatible = "zephyr,modbus-serial"; status = "okay"; };
	  的子节点，iface_name 使用该节点名。
```

## platform/middleware/data/Kconfig
```kconfig
# SPDX-License-Identifier: Apache-2.0
#
# 数据中间件：JSON + CBOR

config PLAT_MW_DATA
	bool "Data middleware (JSON + CBOR)"
	default n
	depends on PLATFORM_SERVICES
	select JSON_LIBRARY
	select ZCBOR
	help
	  启用数据序列化封装（plat_data）：
	  JSON 基于 Zephyr json 库描述符 API；
	  CBOR 基于 zcbor 流式编码（适合 MQTT payload 等紧凑场景）。
```

## platform/middleware/storage/Kconfig
```kconfig
# SPDX-License-Identifier: Apache-2.0
#
# 存储中间件：日志文件系统/键值存储、数据备份恢复/数据校验。
# 当前实现 plat_kv：上游 settings 的薄封装，QEMU 下以 SETTINGS_NONE
# （RAM）运行；真实板卡切换 SETTINGS_FCB/SETTINGS_FILE + LittleFS/NFFS
# 后，应用层接口保持不变。

config PLAT_MW_STORAGE
	bool "Key-value storage middleware (settings based)"
	default y
	depends on PLATFORM_SERVICES
	select SETTINGS
	select SETTINGS_RUNTIME
	help
	  提供 plat_kv_init/plat_kv_get/plat_kv_set 统一 KV 接口，
	  对应用屏蔽后端差异（RAM/FCB/File/NVS）。
```

## platform/middleware/uwb/Kconfig
```kconfig
# SPDX-License-Identifier: Apache-2.0
#
# UWB 中间件：NXP SR040（UCI）

config PLAT_MW_UWB
	bool "UWB middleware (NXP SR040 via UCI)"
	default n
	depends on PLATFORM_SERVICES
	depends on ZEPHYR_NXP_UWBIOT_MODULE
	help
	  启用 UWB 封装（plat_uwb），依赖 nxp-uwbiot 模块
	  （modules/uwb/uwbiot，需加入 ZEPHYR_EXTRA_MODULES）。
	  板级 overlay 声明 nxp,uwb-sr040-device 节点后功能生效，
	  未声明节点时 API 返回 -ENODEV。
```

## platform/subsys/Kconfig
```kconfig
# SPDX-License-Identifier: Apache-2.0
#
# 系统服务层（架构图黄色区域）中由平台层提供/封装的服务。
# 网络协议栈、VFS、TLS、日志、调试、追踪、性能分析等直接复用上游 subsys，
# 在应用 prj.conf 中使能即可，此处只声明平台增值服务。

config PLAT_DEVICE_MGMT
	bool "Device management service (enumeration/health/reset)"
	default y
	depends on PLATFORM_SERVICES
	help
	  设备枚举与发现（STRUCT_SECTION_FOREACH(device)）、设备健康监测、
	  错误计数/复位记录，以及 platform shell 下的 devices 命令。
	  对应架构图“设备管理服务/日志系统”的平台侧部分。

config PLAT_PM
	bool "Platform PM runtime service (device power management)"
	default y
	depends on PLATFORM_SERVICES
	help
	  设备运行时电源管理统一封装（pm_device_runtime 的 plat_* 接口）。
	  对应架构图“设备管理服务 -> 运行时电源管理”。

config PLAT_FS
	bool "Platform filesystem service (LittleFS unified API)"
	default y
	depends on PLATFORM_SERVICES
	depends on FILE_SYSTEM_LITTLEFS
	depends on FILE_SYSTEM_LIB_LINK
	help
	  LittleFS 虚拟文件系统统一封装（plat_fs_* 接口）。
	  对应架构图“系统服务层 -> 虚拟文件系统”。

config PLAT_NET
	bool "Platform network service (IPv4 + MQTT single-link)"
	default y
	depends on PLATFORM_SERVICES
	help
	  网络协议栈统一封装（WiFi + MQTT，蓝牙/蜂窝/TLS 预留）。
	  对应架构图“系统服务层 -> 网络协议栈”。
```

## platform/zephyr/Kconfig
```kconfig
# SPDX-License-Identifier: Apache-2.0
#
# Platform Framework 顶层 Kconfig（由 Zephyr 构建系统经 module.yml 自动 rsource）

menu "Platform Framework"

rsource "../compat/Kconfig.compat"

config PLATFORM_SERVICES
	bool "Enable platform framework core services"
	default y
	help
	  启用树外平台层：版本兼容、统一时钟、设备管理/健康监测服务以及
	  platform shell 命令集。对应架构图“系统服务层”的平台公共部分。

rsource "../subsys/Kconfig"
rsource "../drivers/Kconfig"
rsource "../middleware/Kconfig"
rsource "../hal/Kconfig"

endmenu
```
